## conf/layer.conf
```bitbake
# We have a conf and classes directory, add to BBPATH
BBPATH .= ":${LAYERDIR}"

# We have recipes-* directories, add to BBFILES
BBFILES += "${LAYERDIR}/recipes-*/*/*.bb \
            ${LAYERDIR}/recipes-*/*/*.bbappend"

BBFILE_COLLECTIONS += "meta-benchmark"
BBFILE_PATTERN_meta-benchmark = "^${LAYERDIR}/"
BBFILE_PRIORITY_meta-benchmark = "6"

LAYERDEPENDS_meta-benchmark = "core"
LAYERSERIES_COMPAT_meta-benchmark = "honister"
```
